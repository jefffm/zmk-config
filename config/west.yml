## config/west.yml
```yaml
manifest:
  remotes:
    - name: zmkfirmware
      url-base: https://github.com/zmkfirmware
    # Additional modules containing boards/shields/custom code can be listed here as well
    # See https://docs.zephyrproject.org/3.2.0/develop/west/manifest.html#projects
    - name: dhruvinsh
      url-base: https://github.com/dhruvinsh
    - name: local
      url-base: /Users/jeff/ws/zmk-config
  projects:
    - name: zmk
      remote: zmkfirmware
      revision: main
      import: app/west.yml
    - name: zmk-tri-state
      remote: dhruvinsh
      revision: main
    - name: regret-shield
      remote: local
      revision: main
      path: modules/regret-shield
  self:
    path: config
```

## modules/regret-shield/shields/regret/Kconfig.shield
```kconfig
config SHIELD_REGRET
    def_bool $(shields_list_contains,regret)
    select SPI

config SHIELD_REGRET_MAC
    bool "Re-gret Mac variant"
    default n
    depends on SHIELD_REGRET

config SHIELD_REGRET_WINDOWS
    bool "Re-gret Windows variant"
    default n
    depends on SHIELD_REGRET
```
